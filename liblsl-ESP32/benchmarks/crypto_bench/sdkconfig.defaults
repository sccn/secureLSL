## liblsl-ESP32/benchmarks/crypto_bench/sdkconfig.defaults
```kconfig
# ESP32 target configuration
CONFIG_IDF_TARGET="esp32"

# CPU frequency: max performance for benchmarking
CONFIG_ESP_DEFAULT_CPU_FREQ_MHZ_240=y

# Task watchdog: increase timeout for long benchmarks
CONFIG_ESP_TASK_WDT_TIMEOUT_S=30

# Serial output baud rate
CONFIG_ESP_CONSOLE_UART_BAUDRATE=115200

# Optimization: performance mode
CONFIG_COMPILER_OPTIMIZATION_PERF=y

# Stack size for main task (libsodium needs stack space)
CONFIG_ESP_MAIN_TASK_STACK_SIZE=8192

# Logging level: info (not debug/verbose)
CONFIG_LOG_DEFAULT_LEVEL_INFO=y
```

## liblsl-ESP32/benchmarks/throughput_bench/main/Kconfig.projbuild
```kconfig
menu "Benchmark Configuration"

    choice BENCH_MODE
        prompt "Benchmark mode"
        default BENCH_MODE_OUTLET
        help
            Select whether to run as outlet (push) or inlet (pull).

        config BENCH_MODE_OUTLET
            bool "Outlet (push samples)"

        config BENCH_MODE_INLET
            bool "Inlet (pull samples)"
    endchoice

    config BENCH_CHANNELS
        int "Number of channels"
        default 8
        range 1 128
        help
            Number of float32 channels per sample.

    config BENCH_SAMPLE_RATE
        int "Sampling rate (Hz)"
        default 250
        range 1 1000
        help
            Nominal sampling rate in Hz.

    config BENCH_DURATION
        int "Test duration (seconds)"
        default 60
        range 0 3600
        help
            Duration of the benchmark. 0 = run until reset.

    config BENCH_REPORT_INTERVAL
        int "Report interval (seconds)"
        default 5
        range 1 60
        help
            Seconds between serial progress reports.

    config BENCH_STREAM_NAME
        string "Stream name (outlet mode)"
        default "ESP32Bench"
        help
            LSL stream name when running as outlet.

    config BENCH_TARGET_STREAM
        string "Target stream name (inlet mode)"
        default "DesktopBench"
        help
            LSL stream name to resolve when running as inlet.

    config BENCH_SECURITY_ENABLE
        bool "Enable secureLSL encryption"
        default n
        help
            Enable encrypted streaming. Requires keypair in NVS
            or configured below.

    config ESP_WIFI_SSID
        string "WiFi SSID"
        default "your_ssid"

    config ESP_WIFI_PASSWORD
        string "WiFi Password"
        default "your_password"

    config ESP_MAXIMUM_RETRY
        int "Maximum WiFi retries"
        default 10

    config LSL_SECURITY_PUBKEY
        string "secureLSL public key (base64)"
        default ""
        depends on BENCH_SECURITY_ENABLE

    config LSL_SECURITY_PRIVKEY
        string "secureLSL private key (base64)"
        default ""
        depends on BENCH_SECURITY_ENABLE

endmenu
```

## liblsl-ESP32/benchmarks/throughput_bench/sdkconfig.defaults
```kconfig
# ESP32 target
CONFIG_IDF_TARGET="esp32"
CONFIG_ESP_DEFAULT_CPU_FREQ_MHZ_240=y

# Stack size for main task
CONFIG_ESP_MAIN_TASK_STACK_SIZE=10240

# Logging (INFO for benchmark output)
CONFIG_LOG_DEFAULT_LEVEL_INFO=y

# WiFi
CONFIG_ESP_WIFI_SSID="your_ssid"
CONFIG_ESP_WIFI_PASSWORD="your_password"

# IGMP for multicast (LSL discovery)
CONFIG_LWIP_IGMP=y

# 1000Hz tick rate for precise timing
CONFIG_FREERTOS_HZ=1000

# Extended watchdog timeout for long benchmarks
CONFIG_ESP_TASK_WDT_TIMEOUT_S=120

# Performance optimization
CONFIG_COMPILER_OPTIMIZATION_PERF=y
```

## liblsl-ESP32/examples/basic_inlet/main/Kconfig.projbuild
```kconfig
menu "Example Configuration"

    config ESP_WIFI_SSID
        string "WiFi SSID"
        default "your_ssid"
        help
            SSID (network name) to connect to.

    config ESP_WIFI_PASSWORD
        string "WiFi Password"
        default "your_password"
        help
            WiFi password (WPA2).

    config ESP_MAXIMUM_RETRY
        int "Maximum WiFi connection retries"
        default 10
        help
            Number of times to retry WiFi connection before giving up.

    config LSL_TARGET_STREAM
        string "Target LSL stream name"
        default "DesktopTest"
        help
            Name of the LSL stream to resolve and connect to.

endmenu
```

## liblsl-ESP32/examples/basic_outlet/main/Kconfig.projbuild
```kconfig
menu "Example Configuration"

    config ESP_WIFI_SSID
        string "WiFi SSID"
        default "your_ssid"
        help
            SSID (network name) to connect to.

    config ESP_WIFI_PASSWORD
        string "WiFi Password"
        default "your_password"
        help
            WiFi password (WPA2).

    config ESP_MAXIMUM_RETRY
        int "Maximum WiFi connection retries"
        default 10
        help
            Number of times to retry WiFi connection before giving up.

endmenu
```

## liblsl-ESP32/examples/basic_outlet/sdkconfig.defaults
```kconfig
# ESP32 target
CONFIG_IDF_TARGET="esp32"
CONFIG_ESP_DEFAULT_CPU_FREQ_MHZ_240=y

# Stack size for main task
CONFIG_ESP_MAIN_TASK_STACK_SIZE=8192

# Logging
CONFIG_LOG_DEFAULT_LEVEL_INFO=y

# WiFi
CONFIG_ESP_WIFI_SSID="your_ssid"
CONFIG_ESP_WIFI_PASSWORD="your_password"

# IGMP for multicast support (required for LSL discovery)
CONFIG_LWIP_IGMP=y

# 1000Hz tick rate for precise sample timing (250Hz needs 4ms resolution)
CONFIG_FREERTOS_HZ=1000
```

## liblsl-ESP32/examples/secure_inlet/main/Kconfig.projbuild
```kconfig
menu "Example Configuration"

    config ESP_WIFI_SSID
        string "WiFi SSID"
        default "your_ssid"
        help
            SSID (network name) to connect to.

    config ESP_WIFI_PASSWORD
        string "WiFi Password"
        default "your_password"
        help
            WiFi password (WPA2).

    config ESP_MAXIMUM_RETRY
        int "Maximum WiFi connection retries"
        default 10
        help
            Number of times to retry WiFi connection before giving up.

    config LSL_SECURITY_PUBKEY
        string "secureLSL public key (base64)"
        default ""
        help
            Base64-encoded Ed25519 public key. Must match all devices in the lab.

    config LSL_SECURITY_PRIVKEY
        string "secureLSL private key (base64)"
        default ""
        help
            Base64-encoded Ed25519 private key (64 bytes).

    config LSL_TARGET_STREAM
        string "Target stream name"
        default "DesktopTest"
        help
            Name of the LSL stream to connect to.

endmenu
```

## liblsl-ESP32/examples/secure_inlet/sdkconfig.defaults
```kconfig
# ESP32 target
CONFIG_IDF_TARGET="esp32"
CONFIG_ESP_DEFAULT_CPU_FREQ_MHZ_240=y

# Stack size for main task (security needs more stack for key derivation)
CONFIG_ESP_MAIN_TASK_STACK_SIZE=10240

# Logging
CONFIG_LOG_DEFAULT_LEVEL_INFO=y

# WiFi
CONFIG_ESP_WIFI_SSID="your_ssid"
CONFIG_ESP_WIFI_PASSWORD="your_password"

# IGMP for multicast support (required for LSL discovery)
CONFIG_LWIP_IGMP=y

# 1000Hz tick rate
CONFIG_FREERTOS_HZ=1000
```

## liblsl-ESP32/examples/secure_outlet/main/Kconfig.projbuild
```kconfig
menu "Example Configuration"

    config ESP_WIFI_SSID
        string "WiFi SSID"
        default "your_ssid"
        help
            SSID (network name) to connect to.

    config ESP_WIFI_PASSWORD
        string "WiFi Password"
        default "your_password"
        help
            WiFi password (WPA2).

    config ESP_MAXIMUM_RETRY
        int "Maximum WiFi connection retries"
        default 10
        help
            Number of times to retry WiFi connection before giving up.

    config LSL_SECURITY_PUBKEY
        string "secureLSL public key (base64)"
        default ""
        help
            Base64-encoded Ed25519 public key. Must match all devices in the lab.
            Generate with lsl-keygen or export from desktop secureLSL config.

    config LSL_SECURITY_PRIVKEY
        string "secureLSL private key (base64)"
        default ""
        help
            Base64-encoded Ed25519 private key (64 bytes). Must match the public key.
            WARNING: This is sensitive key material.

endmenu
```

## liblsl-ESP32/tests/build_test/sdkconfig.defaults
```kconfig
CONFIG_IDF_TARGET="esp32"
CONFIG_ESP_DEFAULT_CPU_FREQ_MHZ_240=y
CONFIG_ESP_MAIN_TASK_STACK_SIZE=4096
CONFIG_LOG_DEFAULT_LEVEL_INFO=y
```
